PROVIDE(printf = 0xe315a354);

PROVIDE(memcpy = 0xe31654bc);
PROVIDE(memset = 0xe3165558);
PROVIDE(strncpy = 0xe31661e4);
PROVIDE(snprintf = 0xe31660bc);

PROVIDE(IOS_Alloc = 0xe3166d4c);
PROVIDE(IOS_AllocAligned = 0xe3166d54);
PROVIDE(IOS_Free = 0xe3166d5c);
PROVIDE(IOS_Open = 0xe3166dac);
PROVIDE(IOS_Close = 0xe3166db4);
PROVIDE(IOS_Ioctl = 0xe3166dd4);
PROVIDE(IOS_Ioctlv = 0xe3166ddc);

PROVIDE(acquireNexServiceToken = 0xe30c4404);
PROVIDE(getAccountInfo = 0xe30bfd88);
